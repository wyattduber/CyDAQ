/*
 * CAUTION: This file is automatically generated by Xilinx.
 * Version: VIVADO 2020.1
 * Today is: Wed Mar 15 16:03:19 2023
 */


/dts-v1/;
#include "zynq-7000.dtsi"
#include "pl.dtsi"
#include "pcw.dtsi"
/ {
	chosen {
		bootargs = "earlycon";
		stdout-path = "serial0:115200n8";
	};
	aliases {
		ethernet0 = &gem0;
		i2c0 = &axi_iic_0;
		i2c1 = &i2c0;
		serial0 = &uart1;
		spi0 = &qspi;
		spi1 = &axi_quad_spi_0;
	};
	memory {
		device_type = "memory";
		reg = <0x0 0x40000000>;
	};
};
